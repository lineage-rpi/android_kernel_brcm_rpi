// Definitions for I2C based sensors used in Android
/dts-v1/;
/plugin/;

/ {
    compatible = "brcm,bcm2835";

    fragment@0 {
        target = <&i2c_arm>;
        __dormant__ {
            #address-cells = <1>;
            #size-cells = <0>;
            status = "okay";

            lsm6ds3: lsm6ds3@6b {
                compatible = "st,lsm6ds3";
                reg = <0x6b>;
                interrupt-parent = <&gpio>;
                interrupts = <4 1>;
            };
        };
    };

    fragment@1 {
        target = <&i2c_arm>;
        __dormant__ {
            #address-cells = <1>;
            #size-cells = <0>;
            status = "okay";
            clock-frequency = <400000>;

            mpu6050: mpu6050@68 {
                compatible = "invensense,mpu6050";
                reg = <0x68>;
                interrupt-parent = <&gpio>;
                interrupts = <4 1>;
            };
        };
    };

    __overrides__ {
        addr = <&lsm6ds3>,"reg:0", <&mpu6050>,"reg:0";
        interrupt = <&lsm6ds3>,"interrupts:0", <&mpu6050>,"interrupts:0";
        lsm6ds3 = <0>,"+0";
        mpu6050 = <0>,"+1";
    };
};
